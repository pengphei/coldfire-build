## package/linux-2.6.29/arch/m68k/Kconfig.debug
```kconfig
menu "Kernel hacking"

source "lib/Kconfig.debug"

config BOOTPARAM
	bool 'Compiled-in Kernel Boot Parameter'
	depends on COLDFIRE

config BOOTPARAM_STRING
	string 'Kernel Boot Parameter'
	default 'console=ttyS0,115200'
	depends on BOOTPARAM

endmenu
```

## package/linux-2.6.29/sound/coldfire/Kconfig
```kconfig
menu "ALSA for Coldfire"

config SND_COLDFIRE
	bool "Coldfire sound devices"
	depends on SND
	select SND_PCM
	select SSIAUDIO_USE_EDMA
	default y
	help
	  Support for sound devices specific to Coldfire architectures.

endmenu
```
